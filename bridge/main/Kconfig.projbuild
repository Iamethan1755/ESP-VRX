## bridge/main/Kconfig.projbuild
```kconfig
# SPDX-License-Identifier: GPL-3.0-only
menu "ESP-VRX"

    config BRIDGE_WIFI_SSID
        string "Wi-Fi network name (SSID)"
        default "ESP-VRX"

    config BRIDGE_WIFI_PASSWORD
        string "Wi-Fi password (8+ characters, empty for an open network)"
        default "vrxbridge"

    config BRIDGE_WIFI_CHANNEL
        int "2.4 GHz Wi-Fi channel"
        range 1 13
        default 1

    config BRIDGE_WIFI_TX_POWER_DBM
        int "Wi-Fi transmit power (dBm)"
        range 2 20
        default 13
        help
            Lower power reaches a phone a few metres away and puts less 2.4 GHz
            energy into the C5's receiver next to it.

    choice BRIDGE_SAMPLE_RATE
        prompt "Video bus sample rate"
        default BRIDGE_SAMPLE_20MHZ
        help
            The C5 outputs 20 MS/s of unique samples (each repeated at 40 MHz).
            20 MHz sees every one, so the 5-tap median despeckle filter gets
            enough samples per pixel; 10 MHz halves memory traffic and load.
        config BRIDGE_SAMPLE_10MHZ
            bool "10 MHz"
        config BRIDGE_SAMPLE_20MHZ
            bool "20 MHz"
    endchoice

    config BRIDGE_SAMPLE_MHZ
        int
        default 10 if BRIDGE_SAMPLE_10MHZ
        default 20 if BRIDGE_SAMPLE_20MHZ

    config BRIDGE_GPIO_D0
        int "GPIO for video bit 0 (C5 D4)"
        default 1
    config BRIDGE_GPIO_D1
        int "GPIO for video bit 1 (C5 D5)"
        default 2
    config BRIDGE_GPIO_D2
        int "GPIO for video bit 2 (C5 D6)"
        default 3
    config BRIDGE_GPIO_D3
        int "GPIO for video bit 3 (C5 D7)"
        default 4
    config BRIDGE_GPIO_D4
        int "GPIO for video bit 4 (C5 D8)"
        default 5
    config BRIDGE_GPIO_D5
        int "GPIO for video bit 5 (C5 D9)"
        default 6

    config BRIDGE_KEYS_ON_D0
        bool "Receiver keys on the video bit 0 wire (no extra wire)"
        default y
        help
            The keys (band, channel, scan, menu) go to the C5 over the wire of
            video bit 0 (S3 D0 to C5 D4): the receiver (wifi-bridge branch,
            BRIDGE_KEYS_ON_D4) then listens on D4 instead of outputting bit 0,
            and the video arrives with 5 bits. Off: a separate wire from
            BRIDGE_GPIO_C5_TX through 1 kOhm to the C5's GPIO2 pad (back side).

    config BRIDGE_GPIO_C5_TX
        int "GPIO sending menu/channel keys to the C5 (UART TX)"
        depends on !BRIDGE_KEYS_ON_D0
        default 7
        help
            Wire this pin (D8 on the XIAO ESP32-S3) through a 1 kOhm resistor
            to GPIO2 of the XIAO ESP32-C5 (the MTMS pad on its back). The
            receiver needs the wifi-bridge branch of C5VRX in receiver/.
            D8 is also the SPI screen's clock: with BRIDGE_SPI_DISPLAY, move
            one of them.

    config BRIDGE_GPIO_PCLK_LOOP
        int "Unconnected GPIO that loops the sample clock back"
        default 42
        help
            The camera port needs its clock on a pin. This pin carries the
            sample clock out and back in; never connect anything to it.
            42 is the MTMS pad on the back of the XIAO ESP32-S3.

    config BRIDGE_MAX_FPS
        int "Maximum JPEG frames per second"
        range 1 60
        default 30

    config BRIDGE_JPEG_QUALITY
        int "JPEG quality"
        range 10 100
        default 60

    config BRIDGE_COLOUR
        bool "Colour (NTSC) at boot"
        default y
        help
            Decode the NTSC colour burst and chroma: fields with a burst come
            out in colour (YCbYCr, JPEG 4:2:0), the others in gray. The
            console's m key and the page's Colour button switch it at run time.
            See docs/colour-study.md.

    config BRIDGE_TEST_PATTERN_AT_BOOT
        bool "Start with the NTSC test pattern instead of the C5 input"
        default n

    config BRIDGE_SPI_DISPLAY
        bool "SPI TFT screen (320x240 ILI9341 / ST7789) on D7..D10"
        default n
        help
            Shows the live picture on a 320x240 SPI TFT wired to the XIAO
            ESP32-S3, with no Wi-Fi in between; the phone stream keeps
            working. The common red 2.8"/3.2" ILI9341 board, or an ST7789
            IPS module. Wire RESET and LED (backlight) to 3V3; MISO and the
            touch pins stay unconnected (no S3 pins are left for touch).

    if BRIDGE_SPI_DISPLAY

    choice BRIDGE_DISPLAY_PANEL
        prompt "Screen controller"
        default BRIDGE_DISPLAY_ILI9341
        config BRIDGE_DISPLAY_ILI9341
            bool "ILI9341 (red 2.8\"/3.2\" TN board)"
        config BRIDGE_DISPLAY_ST7789
            bool "ST7789 (IPS module, 240x320)"
    endchoice

    config BRIDGE_DISPLAY_SPI_MHZ
        int "SPI clock (MHz)"
        range 10 80
        default 40
        help
            40 MHz sends a whole 320x240 frame in 31 ms, just enough for
            30 fps; the ILI9341 datasheet only promises 10 MHz, but these
            boards commonly run 40. Lower it if the picture shows wrong
            pixels or stripes (long or loose wires).

    config BRIDGE_DISPLAY_INVERT
        bool "Invert colours (most ST7789 IPS modules need it)"
        default y if BRIDGE_DISPLAY_ST7789
        default n
        help
            On if the picture looks like a photo negative.

    config BRIDGE_DISPLAY_ROTATE_180
        bool "Turn the picture upside down (rotate 180 degrees)"
        default n

    config BRIDGE_DISPLAY_MIRROR
        bool "Mirror the picture"
        default n
        help
            For a module that shows the picture mirrored (text reads
            backwards); combine with the 180 degree rotation if it is then
            upside down.

    config BRIDGE_DISPLAY_GPIO_SCK
        int "GPIO for the screen's SCK (D8)"
        default 7
    config BRIDGE_DISPLAY_GPIO_MOSI
        int "GPIO for the screen's SDI / MOSI (D10)"
        default 9
    config BRIDGE_DISPLAY_GPIO_CS
        int "GPIO for the screen's CS (D9)"
        default 8
    config BRIDGE_DISPLAY_GPIO_DC
        int "GPIO for the screen's DC / RS (D7)"
        default 44
        help
            Never GPIO1..6 (video, keys), 42 (clock loop) or 43 (D6, the
            boot log); the build stops with an error if a screen pin is one
            of the bridge's other pins.

    endif

endmenu
```

## receiver/legacy/c5vrx3/main/Kconfig.projbuild
```kconfig
menu "C5VRX board and video DAC"
    config C5VRX_CUSTOM_BOARD
        bool "Configure a custom ESP32-C5 board"
        default n
        help
            Defaults preserve the XIAO wiring. Use GPIO numbers, not board D/A
            labels. IQ pins are internal diagnostic loopbacks, not analog inputs.
            See docs/custom-board.md for electrical and console restrictions.

    choice C5VRX_DAC_RESOLUTION
        prompt "Physical resistor DAC resolution"
        default C5VRX_DAC_6BIT
        config C5VRX_DAC_6BIT
            bool "6 bits (existing resistor network)"
        config C5VRX_DAC_8BIT
            bool "8 bits (experimental Phase8, requires a new resistor network)"
            depends on C5VRX_CUSTOM_BOARD && C5VRX_PHASE8_HR_LIVE_TEST
    endchoice

    config C5VRX_DAC_BITS
        int
        default 8 if C5VRX_DAC_8BIT
        default 6

    config C5VRX_IQ_D0_GPIO
        int "IQ bit 0 GPIO" if C5VRX_CUSTOM_BOARD
        range -1 28
        default 1
    config C5VRX_IQ_D1_GPIO
        int "IQ bit 1 GPIO" if C5VRX_CUSTOM_BOARD
        range -1 28
        default 0
    config C5VRX_IQ_D2_GPIO
        int "IQ bit 2 GPIO" if C5VRX_CUSTOM_BOARD
        range -1 28
        default 25
    config C5VRX_IQ_D3_GPIO
        int "IQ bit 3 GPIO" if C5VRX_CUSTOM_BOARD
        range -1 28
        default 7
    config C5VRX_IQ_D4_GPIO
        int "IQ bit 4 GPIO" if C5VRX_CUSTOM_BOARD
        range -1 28
        default 10
    config C5VRX_IQ_D5_GPIO
        int "IQ bit 5 GPIO" if C5VRX_CUSTOM_BOARD
        range -1 28
        default 5
    config C5VRX_IQ_D6_GPIO
        int "IQ bit 6 GPIO" if C5VRX_CUSTOM_BOARD
        range -1 28
        default 3
    config C5VRX_IQ_D7_GPIO
        int "IQ bit 7 GPIO" if C5VRX_CUSTOM_BOARD
        range -1 28
        default 4
    config C5VRX_DAC_D0_GPIO
        int "DAC bit 0 GPIO" if C5VRX_CUSTOM_BOARD
        range -1 28
        default 23
    config C5VRX_DAC_D1_GPIO
        int "DAC bit 1 GPIO" if C5VRX_CUSTOM_BOARD
        range -1 28
        default 24
    config C5VRX_DAC_D2_GPIO
        int "DAC bit 2 GPIO" if C5VRX_CUSTOM_BOARD
        range -1 28
        default 11
    config C5VRX_DAC_D3_GPIO
        int "DAC bit 3 GPIO" if C5VRX_CUSTOM_BOARD
        range -1 28
        default 12
    config C5VRX_DAC_D4_GPIO
        int "DAC bit 4 GPIO" if C5VRX_CUSTOM_BOARD
        range -1 28
        default 8
    config C5VRX_DAC_D5_GPIO
        int "DAC bit 5 GPIO" if C5VRX_CUSTOM_BOARD
        range -1 28
        default 9
    config C5VRX_DAC_D6_GPIO
        int "DAC bit 6 GPIO" if C5VRX_CUSTOM_BOARD && C5VRX_DAC_8BIT
        range -1 28
        default -1
    config C5VRX_DAC_D7_GPIO
        int "DAC bit 7 GPIO" if C5VRX_CUSTOM_BOARD && C5VRX_DAC_8BIT
        range -1 28
        default -1
    config C5VRX_BUTTON_GPIO
        int "Active-low menu button GPIO (-1 to disable)" if C5VRX_CUSTOM_BOARD
        range -1 28
        default 28
endmenu

menu "C5VRX diagnostic probes"
    config C5VRX_PHY_PHASE_TAP_PROBE
        bool "Capture bounded MODEM_DIAG lane traces at boot, then start video"
        default n
        help
            Capture all 32 MODEM_DIAG lanes under four previously tested
            selector states on the production IQ GPIOs before video starts.
            Restore all selector registers and the normal IQ routing after
            capture. CPU snapshots are asynchronous and cannot alone prove a
            40 MS/s phase tap. This option is for an experimental PR build.

    config C5VRX_BS_RELATIVE_WORKER_PROBE
        bool "Run Counter-A relative-mux loopback oracle before starting video"
        default n
        help
            Run a finite two-bundle BitScrambler loopback test at boot and
            print BS_REL_WORKER PASS/FAIL, then start the normal RF/video path.

    config C5VRX_BS_RELATIVE_MIDDLE_PROBE
        bool "Run alternating middle/endpoint relative-mux loopback probe before starting video"
        default y
        help
            Run a finite two-bundle BitScrambler loopback test at boot to prove
            alternating middle-sample and endpoint-sample Phase5 extraction,
            then start the normal RF/video path.

    config C5VRX_BS_ADDCTIA_PROBE
        bool "Run Counter-A ADDCTIA hardware subtraction loopback probe before starting video"
        default y
        help
            Run a finite BitScrambler loopback test at boot to prove
            single-cycle Counter-A hardware subtraction (ADDCTIAL + LDCTIAL)
            and compact 32-entry DAC lookup for Phase5-360, then start the
            normal RF/video path.
endmenu

menu "C5VRX experimental video demodulators"
    config C5VRX_PHASE8_HR_LIVE_TEST
        bool "Run full-range adjacent Phase8 on live 6BIT@40 video"
        default y
        help
            Experimental full signed Phase8 delta mapping plus Direct Gain V3.
            Maps -128..+127 phase bins across the 64 DAC levels and forces
            6BIT@40 output. A phase step crossing +/-180 degrees still aliases.

    config C5VRX_PHASE5_360_LIVE
        bool "Use Phase5-360 research program (Golden DAC output only)"
        default y
        help
            Load the two-bundle middle-sample routing experiment. Both worker
            branches currently output the same Golden DAC bytes. No adjacent
            winding correction is active in the live firmware.

    config C5VRX_RELATIVE_GOLDEN_LIVE
        bool "Use relative-mux Golden in the live 6-bit video path"
        default n
        help
            Replace only the 6-bit Golden BitScrambler program with the
            two-bundle Counter-A relative-mux oracle. Intended for live
            equivalence testing; no winding correction is performed.
endmenu

config C5VRX_DIRECT_GAIN_V3_EXPERIMENT
    bool "Run predictive Direct Gain V3 on the default automatic RX profile"
    default y
    help
        Experimental issue #107 build. The existing live demodulator stays
        selected, while V3 alone owns automatic RF gain on the default
        profile. Hardware gain and video validation is required before merge.
```

## receiver/legacy/c5vrx4/main/Kconfig.projbuild
```kconfig
menu "C5VRX diagnostic probes"
    config C5VRX_PHY_PHASE_TAP_PROBE
        bool "Capture bounded MODEM_DIAG lane traces at boot, then start video"
        default n
        help
            Capture all 32 MODEM_DIAG lanes under four previously tested
            selector states on the production IQ GPIOs before video starts.
            Restore all selector registers and the normal IQ routing after
            capture. CPU snapshots are asynchronous and cannot alone prove a
            40 MS/s phase tap. This option is for an experimental PR build.

    config C5VRX_BS_RELATIVE_WORKER_PROBE
        bool "Run Counter-A relative-mux loopback oracle before starting video"
        default n
        help
            Run a finite two-bundle BitScrambler loopback test at boot and
            print BS_REL_WORKER PASS/FAIL, then start the normal RF/video path.

    config C5VRX_BS_RELATIVE_MIDDLE_PROBE
        bool "Run alternating middle/endpoint relative-mux loopback probe before starting video"
        default y
        help
            Run a finite two-bundle BitScrambler loopback test at boot to prove
            alternating middle-sample and endpoint-sample Phase5 extraction,
            then start the normal RF/video path.

    config C5VRX_BS_ADDCTIA_PROBE
        bool "Run Counter-A ADDCTIA hardware subtraction loopback probe before starting video"
        default y
        help
            Run a finite BitScrambler loopback test at boot to prove
            single-cycle Counter-A hardware subtraction (ADDCTIAL + LDCTIAL)
            and compact 32-entry DAC lookup for Phase5-360, then start the
            normal RF/video path.
endmenu

menu "C5VRX experimental video demodulators"
    config C5VRX_PHASE8_HR_LIVE_TEST
        bool "Run full-range adjacent Phase8 on live 6BIT@40 video"
        default y
        help
            Experimental full signed Phase8 delta mapping plus Direct Gain V3.
            Maps -128..+127 phase bins across the 64 DAC levels and forces
            6BIT@40 output. A phase step crossing +/-180 degrees still aliases.

    config C5VRX_PHASE5_360_LIVE
        bool "Use Phase5-360 research program (Golden DAC output only)"
        default y
        help
            Load the two-bundle middle-sample routing experiment. Both worker
            branches currently output the same Golden DAC bytes. No adjacent
            winding correction is active in the live firmware.

    config C5VRX_RELATIVE_GOLDEN_LIVE
        bool "Use relative-mux Golden in the live 6-bit video path"
        default n
        help
            Replace only the 6-bit Golden BitScrambler program with the
            two-bundle Counter-A relative-mux oracle. Intended for live
            equivalence testing; no winding correction is performed.
endmenu

config C5VRX_DIRECT_GAIN_V3_EXPERIMENT
    bool "Run predictive Direct Gain V3 on the default automatic RX profile"
    default y
    help
        Experimental issue #107 build. The existing live demodulator stays
        selected, while V3 alone owns automatic RF gain on the default
        profile. Hardware gain and video validation is required before merge.
```
