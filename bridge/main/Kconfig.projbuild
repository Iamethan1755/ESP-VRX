## receiver/legacy/c5vrx4/sdkconfig.defaults
```kconfig
CONFIG_PARTITION_TABLE_CUSTOM_FILENAME="partitions.csv"
CONFIG_GPTIMER_ISR_CACHE_SAFE=y
CONFIG_GPTIMER_CTRL_FUNC_IN_IRAM=y
CONFIG_C5VRX_PHASE8_HR_LIVE_TEST=n
CONFIG_C5VRX_DIRECT_GAIN_V3_EXPERIMENT=y

CONFIG_C5VRX_BS_RELATIVE_MIDDLE_PROBE=n
CONFIG_C5VRX_BS_ADDCTIA_PROBE=n
```
